## rootfs/Config.in
```kconfig
source "$BR2_EXTERNAL_KOBRA_PATH/package/kobra-abctl/Config.in"
source "$BR2_EXTERNAL_KOBRA_PATH/package/rtk-hciattach/Config.in"
source "$BR2_EXTERNAL_KOBRA_PATH/package/python-streaming-form-data/Config.in"
source "$BR2_EXTERNAL_KOBRA_PATH/package/kobra-pywheels/Config.in"
source "$BR2_EXTERNAL_KOBRA_PATH/package/klipper/Config.in"
source "$BR2_EXTERNAL_KOBRA_PATH/package/moonraker/Config.in"
source "$BR2_EXTERNAL_KOBRA_PATH/package/mainsail/Config.in"
source "$BR2_EXTERNAL_KOBRA_PATH/package/mainsail-config/Config.in"
source "$BR2_EXTERNAL_KOBRA_PATH/package/kobra-numpy/Config.in"
source "$BR2_EXTERNAL_KOBRA_PATH/package/helixscreen/Config.in"
source "$BR2_EXTERNAL_KOBRA_PATH/package/kobra-webcam/Config.in"
source "$BR2_EXTERNAL_KOBRA_PATH/package/klipper-host-mcu/Config.in"
source "$BR2_EXTERNAL_KOBRA_PATH/package/kobra-acepro/Config.in"
```

## rootfs/package/helixscreen/Config.in
```kconfig
config BR2_PACKAGE_HELIXSCREEN
	bool "helixscreen"
	depends on BR2_arm
	help
	  HelixScreen touch UI for Klipper (LVGL 9, fbdev + evdev) in
	  /opt/helixscreen. Prebuilt static armv7 release binary (the
	  "ad5m" build: Cortex-A7, 800x480), printer images of other
	  printers removed. Started by S70helixscreen after Moonraker.

	  https://github.com/prestonbrown/helixscreen
```

## rootfs/package/klipper-host-mcu/Config.in
```kconfig
config BR2_PACKAGE_KLIPPER_HOST_MCU
	bool "klipper-host-mcu"
	depends on BR2_PACKAGE_KLIPPER
	help
	  Klipper "Linux MCU" (klipper_mcu) built from the same Klipper
	  source as klippy. It gives Klipper the host board's own pins:
	  the chamber light (GPIO3_C5 = gpio117) and the buzzer
	  (pwmchip0/pwm0). S59klipper-mcu starts it before klippy on
	  /tmp/klipper_host_mcu.
```

## rootfs/package/klipper/Config.in
```kconfig
config BR2_PACKAGE_KLIPPER
	bool "klipper"
	depends on BR2_PACKAGE_PYTHON3
	select BR2_PACKAGE_PYTHON_GREENLET
	select BR2_PACKAGE_PYTHON_CFFI
	select BR2_PACKAGE_PYTHON_SERIAL
	select BR2_PACKAGE_PYTHON_JINJA2
	select BR2_PACKAGE_PYTHON_MARKUPSAFE
	select BR2_PACKAGE_PYTHON3_ZLIB
	help
	  Klipper host (klippy) from the Kobra-S1 fork (cs1237, probe_ks1,
	  lis2dw12), installed read-only in /usr/lib/klipper with a
	  cross-built klippy/chelper/c_helper.so.
```

## rootfs/package/kobra-abctl/Config.in
```kconfig
config BR2_PACKAGE_KOBRA_ABCTL
	bool "kobra-abctl"
	help
	  Minimal replacement for Rockchip rk_ota: marks the running A/B
	  slot (tries_remaining refill) and switches to the other slot.
```

## rootfs/package/kobra-acepro/Config.in
```kconfig
config BR2_PACKAGE_KOBRA_ACEPRO
	bool "kobra-acepro"
	depends on BR2_PACKAGE_KLIPPER
	help
	  Klipper driver for the Anycubic ACE Pro multi-colour unit
	  (Kobra-S1/ACEPRO, the one the vanilla-klipper Rinkhals app ships):
	  klippy extras ace/, temperature_ace, virtual_pins, plus its
	  ace_KS1.cfg / ace_macros_generic.cfg as printer_data defaults.
	  The ACE talks over USB CDC-ACM (/dev/ttyACM*, found by USB id).
	  Not active: nothing includes ace_KS1.cfg, and its macros expect the
	  vanilla-klipper macro set (see docs/peripherals.md, "ACE Pro").
```

## rootfs/package/kobra-numpy/Config.in
```kconfig
config BR2_PACKAGE_KOBRA_NUMPY
	bool "kobra-numpy"
	depends on BR2_PACKAGE_PYTHON3
	depends on BR2_INSTALL_LIBSTDCPP
	depends on BR2_arm && BR2_ARM_EABIHF
	help
	  NumPy 1.23.5 (same source and options as Buildroot's python-numpy)
	  for the uClibc toolchain. Buildroot's python-numpy is limited to
	  glibc/musl because uClibc-ng ships no fenv.h for ARM; this package
	  adds a small header-only fenv.h for ARM hard-float (FPSCR). Needed
	  by Klipper's SHAPER_CALIBRATE / TEST_RESONANCES.
```

## rootfs/package/kobra-pywheels/Config.in
```kconfig
config BR2_PACKAGE_KOBRA_PYWHEELS
	bool "kobra-pywheels"
	depends on BR2_PACKAGE_PYTHON3
	select BR2_PACKAGE_LIBSODIUM # libnacl (ctypes)
	help
	  Pure-Python packages Moonraker needs that Buildroot 2023.02 does not
	  have: inotify-simple, libnacl, importlib-metadata, zipp (pinned
	  py3-none-any wheels) and dbus-fast (pure-Python fallback from the
	  sdist, no Cython extensions).
```

## rootfs/package/kobra-webcam/Config.in
```kconfig
config BR2_PACKAGE_KOBRA_WEBCAM
	bool "kobra-webcam"
	depends on BR2_USE_MMU
	depends on BR2_TOOLCHAIN_HAS_THREADS
	depends on !BR2_STATIC_LIBS
	select BR2_PACKAGE_MJPG_STREAMER
	help
	  The printer camera (UVC on the GL850G hub) as an MJPEG stream:
	  mjpg-streamer (input_uvc + output_http) on 127.0.0.1:8080,
	  started by S65webcam with the settings from
	  printer_data/config/webcam.conf. lighttpd serves it as /webcam/.
	  Removes the mjpg-streamer plugins, web pages and jpeg tools the
	  printer does not use.
```

## rootfs/package/mainsail-config/Config.in
```kconfig
config BR2_PACKAGE_MAINSAIL_CONFIG
	bool "mainsail-config"
	help
	  mainsail.cfg client macros (mainsail-crew/mainsail-config), shipped
	  with the printer_data defaults.
```

## rootfs/package/mainsail/Config.in
```kconfig
config BR2_PACKAGE_MAINSAIL
	bool "mainsail"
	help
	  Mainsail web UI (static release zip) in /usr/share/mainsail.
```

## rootfs/package/moonraker/Config.in
```kconfig
config BR2_PACKAGE_MOONRAKER
	bool "moonraker"
	depends on BR2_PACKAGE_PYTHON3
	select BR2_PACKAGE_PYTHON_TORNADO
	select BR2_PACKAGE_PYTHON_SERIAL
	select BR2_PACKAGE_PYTHON_PILLOW
	select BR2_PACKAGE_PYTHON_DISTRO
	select BR2_PACKAGE_PYTHON_JINJA2
	select BR2_PACKAGE_PYTHON_STREAMING_FORM_DATA
	select BR2_PACKAGE_KOBRA_PYWHEELS
	select BR2_PACKAGE_PYTHON3_SQLITE
	help
	  Moonraker API server, installed read-only in /usr/lib/moonraker.
```

## rootfs/package/python-streaming-form-data/Config.in
```kconfig
config BR2_PACKAGE_PYTHON_STREAMING_FORM_DATA
	bool "python-streaming-form-data"
	help
	  Streaming parser for multipart/form-data (Moonraker uploads).
```

## rootfs/package/rtk-hciattach/Config.in
```kconfig
config BR2_PACKAGE_RTK_HCIATTACH
	bool "rtk-hciattach"
	help
	  Realtek rtk_hciattach (H5 attach + firmware download) for the
	  RTL8723DS Bluetooth part, from radxa/rkwifibt (tools/rtk_hciattach).
	  The source dir is passed in by tools/build_rootfs.sh
	  (KOBRA_RKWIFIBT_DIR, pinned commit).
```
